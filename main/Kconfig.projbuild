## main/Kconfig.projbuild
```kconfig
menu "Custom Project Configuration"

config ALLOW_PRINTF_ON_UART
    bool "Enable/Disable printf function on UART0"
    default false

config WIFI_SSID
    string "WiFi SSID"
    default "WIFI_SSID"
    help
        SSID (network name) for the example to connect to.

config WIFI_PASSWORD
    string "WiFi Password"
    default "mypassword"
    help
        WiFi password (WPA or WPA2) for the example to use.
        Can be left blank if the network has no security set.

config MQTT_BROKER
    string "MQTT broker"
    default "test.mosquitto.org"
    help
        MQTT broker which you want to login, either IP address or domain name is OK.

config MQTT_PORT
    int "Default MQTT port"
    default 1883
    help
        MQTT port.

config MQTT_PUB_TOPIC
    string "MQTT subscribe topic"
    default "your_channel"
    help
        MQTT subscribe topic to MQTT broker.

choice MQTT_PUB_QOS
    prompt "MQTT Subscribe QoS"
    default PUB_QOS0
    help
        MQTT subcribe QoS level.

config PUB_QOS0
    bool "QOS0"
config PUB_QOS1
    bool "QOS1"
config PUB_QOS2
    bool "QOS2"
endchoice

config DEFAULT_MQTT_PUB_QOS
    int
    default 0 if PUB_QOS0
    default 1 if PUB_QOS1
    default 2 if PUB_QOS2

endmenu
```
